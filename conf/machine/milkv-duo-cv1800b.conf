## conf/machine/milkv-duo-cv1800b.conf
```bitbake
#@TYPE: Machine
#@NAME: milkv-duo-cv1800b
#@SOC: Milk-V CV1800B
#@DESCRIPTION: Machine configuration for the beta BeagleV Starlight board

require conf/machine/include/riscv/tune-riscv.inc

MACHINE_FEATURES = "screen keyboard ext2 ext3 serial"

KERNEL_CLASSES = "kernel-fitimage"
KERNEL_IMAGETYPE = "fitImage"
UBOOT_ENV ?= "boot"
UBOOT_ENV_SUFFIX = "scr.uimg"
PREFERRED_PROVIDER_virtual/kernel ?= "linux-duo-dev"
PREFERRED_PROVIDER_virtual/bootloader ?= "u-boot-duo"

PREFERRED_VERSION_openocd-native = "riscv"
PREFERRED_VERSION_openocd = "riscv"

EXTRA_IMAGEDEPENDS += "opensbi-duo"
RISCV_SBI_PLAT = "generic"

## This sets u-boot as the default OpenSBI payload
RISCV_SBI_PAYLOAD ?= "u-boot.bin"

RISCV_SBI_FDT ?= "cv1800b_milkv_duo_sd.dtb"

SERIAL_CONSOLES = "115200;ttyS0"

MACHINE_EXTRA_RRECOMMENDS += " kernel-modules"

IMAGE_FSTYPES += "wic.gz wic.bmap ext4"
KERNEL_DEVICETREE ?= "duo/cv1800b_milkv_duo_sd.dtb"

## Do not update fstab file when using wic images
WIC_CREATE_EXTRA_ARGS ?= "--no-fstab-update"

EXTRA_IMAGEDEPENDS += "u-boot-duo"
UBOOT_MACHINE = "cv1800b_milkv_duo_sd_defconfig"

UBOOT_ENTRYPOINT = "0x80200000"
UBOOT_DTB_LOADADDRESS = "0x82200000"
UBOOT_DTB = "1"
UBOOT_DTB_BINARY = "cv1800b_milkv_duo_sd.dtb"

## wic default support
WKS_FILE_DEPENDS ?= " \
    opensbi \
    e2fsprogs-native \
    bmap-tools-native \
"

IMAGE_BOOT_FILES ?= " \
    fw_payload.bin \
    ${KERNEL_IMAGETYPE} \
    ${RISCV_SBI_FDT}  \
    boot.scr.uimg \
"

WKS_FILE ?= "duo.wks"
```

## wic/duo.wks
```
# short-description: Create SD card image for Milk-V Duo development board

part /boot --source bootimg-partition --ondisk mmcblk0 --fstype=vfat --label boot --active --size=128M --align 4096
part / --source rootfs --ondisk mmcblk0 --fstype=ext4 --label root --align 4096 --size 512M
```
